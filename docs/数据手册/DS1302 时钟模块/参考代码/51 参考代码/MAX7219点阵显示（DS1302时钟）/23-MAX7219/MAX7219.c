#include <REGX52.H>
#include "Delay1ms.h"
#define   LEDNUMBER   5        // 点阵数量  
#define   MODE      0x09       // 译码方式 (1为BCD译码, 0为不译码)
#define   BRIGHT    0x0A       // 亮度设置 (0x00~0x0F, 0x01最暗，0x0F最亮)
#define   SCANNING  0x0B       // 扫描位数 (0x00~0x07, 选择扫描1-8个LED)
#define   STANDBY   0x0C       // 待机模式 (1为正常工作模式, 0为停机模式，显示熄灭但数据不消失)
#define   DISTEST   0x0F       // 显示测试 (0为按数据正常显示，1为测试模式,即LED全亮)
unsigned char BrightSet = 0x08; // 用于外部按键调节亮度
sbit MAX7219_DIN = P2^0;
sbit MAX7219_CS = P2^1;
sbit MAX7219_CLOK = P2^2;

unsigned char code MAX7219DATA[][8] = {
	// 逐行式
	{0x3C,0x66,0x66,0x66,0x66,0x66,0x66,0x3C},/*"0",0*/
	{0x18,0x38,0x18,0x18,0x18,0x18,0x18,0x3C},/*"1",1*/
	{0x3C,0x66,0x66,0x0C,0x18,0x30,0x60,0x7E},/*"2",2*/
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	{0x00,0x00,0x00,0x00,0x00,0x00,0x00,0x00},/*" ",37*/

};


// 数据缓存
unsigned char  DisplayData[5][8] = {
	{0x3C,0x66,0x66,0x66,0x66,0x66,0x66,0x3C},/*0*/
	{0x3C,0x66,0x66,0x66,0x66,0x66,0x66,0x3C},/*1*/
	{0x3C,0x66,0x66,0x66,0x66,0x66,0x66,0x3C},/*2*/
	{0x3C,0x66,0x66,0x66,0x66,0x66,0x66,0x3C},/*3*/
	{0x3C,0x66,0x66,0x66,0x66,0x66,0x66,0x3C},/*4*/
};

// 写入命令和数据
void MAX7219_Write(unsigned char Add, Data)
{
	unsigned char i;
	MAX7219_CS = 0;
	for (i = 0; i < 8; i++)
	{
		MAX7219_CLOK = 0;
		MAX7219_DIN = Add & (0x80 >> i);
		MAX7219_CLOK = 1;

	}
	
	for (i = 0; i < 8; i++)
	{
		MAX7219_CLOK = 0;
		MAX7219_DIN = Data & (0x80 >> i);
		MAX7219_CLOK = 1;
	}
	
}

// 初始化
void MAX7219_Init()
{
	unsigned char i;
	MAX7219_CS = 0;
	for (i = 0; i < LEDNUMBER; i++)
	{
		MAX7219_Write(MODE, 0x00);   // 译码方式 (1为BCD译码, 0为不译码)
	}
	MAX7219_CS = 1;

	MAX7219_CS = 0;
	for (i = 0; i < LEDNUMBER; i++)
	{
		MAX7219_Write(BRIGHT, BrightSet); // 亮度设置 (0x00~0x0F, 0x01最暗，0x0F最亮)
	}
	MAX7219_CS = 1;

	MAX7219_CS = 0;
	for (i = 0; i < LEDNUMBER; i++)
	{
		MAX7219_Write(SCANNING, 0x07); // 扫描位数 (0x00~0x07, 选择扫描1-8个LED)
	} 
	MAX7219_CS = 1;

	MAX7219_CS = 0;
	for (i = 0; i < LEDNUMBER; i++)
	{
		MAX7219_Write(STANDBY, 0x01); // 待机模式 (1为正常工作模式, 0为停机模式，显示熄灭但数据不消失)
	}
	MAX7219_CS = 1;

	MAX7219_CS = 0;
	for (i = 0; i < LEDNUMBER; i++)
	{
		MAX7219_Write(DISTEST, 0x00); // 显示测试 (0为按数据正常显示，1为测试模式,即LED全亮)
	}
	MAX7219_CS = 1;	
}


// 更新显示
void MAX7219_Display()
{
	unsigned char i, j;

	for (j = 0; j < 8; j++)
	{
		MAX7219_CS = 0;
		for (i = 0; i < LEDNUMBER; i++)
		{
			MAX7219_Write(j+1, DisplayData[i][j]);
		}
		MAX7219_CS = 1;
		Delay1ms(15); // 一定延时可以让更新数字时带有类似平滑的效果
	}
	
}
